# FL_BOOTOVER_MAILBOX_356.0 register map
Vendor: Texas Instruments
Peripheral module from a debugger description file (folder MSP432).
Registers are 32-bit, access not given, no defined reset value unless marked. A register's access mark holds for its fields unless they carry their own. Offsets are as the file gives them; lines under a group give offsets from that group; [hi:lo] are bit positions; {n}, {i} and the like mark numbered series; 'fields as' and 'values as' point back to an identical list; <NAME> marks a mode.

## FL_BOOTOVER_MAILBOX
0x00 MB_START — Flash MailBox start: 0x0115ACF6
0x04 CMD — Command for Boot override operations.
0x10 JTAG_SWD_LOCK_SECEN — JTAG and SWD Lock Enable
0x14 JTAG_SWD_LOCK_AES_INIT_VECT — JTAG and SWD lock AES initialization vector for AES-CBC
0x18 JTAG_SWD_LOCK_AES_INIT_VECT — JTAG and SWD lock AES initialization vector for AES-CBC
0x1C JTAG_SWD_LOCK_AES_INIT_VECT — JTAG and SWD lock AES initialization vector for AES-CBC
0x20 JTAG_SWD_LOCK_AES_INIT_VECT — JTAG and SWD lock AES initialization vector for AES-CBC
0x24 JTAG_SWD_LOCK_AES_SECKEYS — JTAG and SWD lock AES CBC security Keys 0-7.
0x28 JTAG_SWD_LOCK_AES_SECKEYS — JTAG and SWD lock AES CBC security Keys 0-7.
0x2C JTAG_SWD_LOCK_AES_SECKEYS — JTAG and SWD lock AES CBC security Keys 0-7.
0x30 JTAG_SWD_LOCK_AES_SECKEYS — JTAG and SWD lock AES CBC security Keys 0-7.
0x34 JTAG_SWD_LOCK_AES_SECKEYS — JTAG and SWD lock AES CBC security Keys 0-7.
0x38 JTAG_SWD_LOCK_AES_SECKEYS — JTAG and SWD lock AES CBC security Keys 0-7.
0x3C JTAG_SWD_LOCK_AES_SECKEYS — JTAG and SWD lock AES CBC security Keys 0-7.
0x40 JTAG_SWD_LOCK_AES_SECKEYS — JTAG and SWD lock AES CBC security Keys 0-7.
0x44 JTAG_SWD_LOCK_UNENC_PWD — JTAG and SWD lock unencrypted password
0x48 JTAG_SWD_LOCK_UNENC_PWD — JTAG and SWD lock unencrypted password
0x4C JTAG_SWD_LOCK_UNENC_PWD — JTAG and SWD lock unencrypted password
0x50 JTAG_SWD_LOCK_UNENC_PWD — JTAG and SWD lock unencrypted password
0x54 JTAG_SWD_LOCK_ACK — Acknowledgment for JTAG and SWD Lock command
0x1E0 BSL_ENABLE
0x1E4 BSL_START_ADDRESS — Contains the pointer to the BSL function.
0x1E8 BSL_PARAMETERS — BSL hardware invoke conifguration field.
0x1F4 BSL_ACK — Acknowledgment for the BSL Configuration Command
0x1F8 JTAG_SWD_LOCK_ENCPAYLOADADD — Start address where the payload is loaded in the device.
0x1FC JTAG_SWD_LOCK_ENCPAYLOADLEN — Length of the encrypted payload in bytes
0x200 JTAG_SWD_LOCK_DST_ADDR — Destination address where the final data needs to be stored into the device.
0x204 ENC_UPDATE_ACK — Acknowledgment for JTAG and SWD Lock Encrypted Update Command
0x250 FACTORY_RESET_ENABLE — Enable/Disable Factory Reset
0x254 FACTORY_RESET_PWDEN — Factory reset password enable
0x258 FACTORY_RESET_PWD — 128-bit Password for factory reset to be saved into the device.
0x25C FACTORY_RESET_PWD — 128-bit Password for factory reset to be saved into the device.
0x260 FACTORY_RESET_PWD — 128-bit Password for factory reset to be saved into the device.
0x264 FACTORY_RESET_PWD — 128-bit Password for factory reset to be saved into the device.
0x268 FACTORY_RESET_PARAMS_ACK — Acknowledgment for the Factory Reset Params Command
0x270 FACTORY_RESET_PASSWORD — 128-bit Password for factory reset.
0x274 FACTORY_RESET_PASSWORD — 128-bit Password for factory reset.
0x278 FACTORY_RESET_PASSWORD — 128-bit Password for factory reset.
0x27C FACTORY_RESET_PASSWORD — 128-bit Password for factory reset.
0x280 FACTORY_RESET_ACK — Acknowledgment for the Factory Reset Command
0x28C MB_END — Mailbox end
