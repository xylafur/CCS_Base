# PSILSS0_CFG_MMRS2 register map
Vendor: Texas Instruments
Peripheral module from a debugger description file (folder am65x).
Registers are 32-bit, read-only, reset 0x66C44100 unless marked. A register's access mark holds for its fields unless they carry their own. Offsets are as the file gives them; lines under a group give offsets from that group; [hi:lo] are bit positions; {n}, {i} and the like mark numbered series; 'fields as' and 'values as' point back to an identical list; <NAME> marks a mode.

## PSILSS0_CFG_MMRS2
0x00 PSIL_CFG_PID — The Revision Register contains the major and minor revisions for the module.
  [31:0] REV — TI internal data.
0x04 PSIL_CFG_CONFIG reset 0x1C — The Config Register shows configured params.
  [15:0] ENDPOINTS — Number of endpoints supported.
0x10 PSIL_CFG_EVENT rw reset 0xFFFF — The Event Register defines the event to produce for a link down event.
  [15:0] EVT — The event to produce.
0x20 PSIL_CFG_LINK reset not defined — The Link Register shows the current status of the endpoint links.
  [31:0] STATUS — The status of the endpoint links.
0x40 PSIL_CFG_DOWN access not given reset 0x0 — The Link Down Register shows which links are down for the endpoints.
  [31:0] STATUS — The down status of the endpoint links. (access RW1C)
